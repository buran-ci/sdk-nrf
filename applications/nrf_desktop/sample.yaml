## applications/nrf_desktop/sample.yaml
```yaml
sample:
  name: nRF52 Desktop
  description: BLE HID device reference design
tests:
  applications.nrf_desktop.zdebug:
    build_only: true
    build_on_all: true
    tags: bluetooth ci_build
  applications.nrf_desktop.zdebug_b0:
    build_only: true
    build_on_all: true
    tags: bluetooth ci_build
    extra_args: "CMAKE_BUILD_TYPE=ZDebugB0"
  applications.nrf_desktop.zdebug_splitll:
    build_only: true
    build_on_all: true
    tags: bluetooth ci_build
    extra_args: "CMAKE_BUILD_TYPE=ZDebugSplitLL"
  applications.nrf_desktop.zdebug_mcuboot:
    build_only: true
    build_on_all: true
    tags: bluetooth ci_build
    extra_args: "CMAKE_BUILD_TYPE=ZDebugMCUBoot"
  applications.nrf_desktop.zrelease:
    build_only: true
    build_on_all: true
    tags: bluetooth ci_build
    extra_args: "CMAKE_BUILD_TYPE=ZRelease"
  applications.nrf_desktop.zrelease_b0:
    build_only: true
    build_on_all: true
    tags: bluetooth ci_build
    extra_args: "CMAKE_BUILD_TYPE=ZReleaseB0"
  applications.nrf_desktop.zrelease_splitll:
    build_only: true
    build_on_all: true
    tags: bluetooth ci_build
    extra_args: "CMAKE_BUILD_TYPE=ZReleaseSplitLL"
  applications.nrf_desktop.zrelease_mcuboot:
    build_only: true
    build_on_all: true
    tags: bluetooth ci_build
    extra_args: "CMAKE_BUILD_TYPE=ZReleaseMCUBoot"
```

## samples/bluetooth/central_bas/sample.yaml
```yaml
sample:
  name: BLE Central BAS
  description: Bluetooth Low Energy central battery service sample
tests:
  samples.bluetooth.central_bas:
    harness: bluetooth
    tags: bluetooth
  samples.bluetooth.central_bas.build:
    build_only: true
    build_on_all: true
      nrf5340dk_nrf5340_cpuapp nrf5340dk_nrf5340_cpuappns
    tags: bluetooth ci_build
```

## samples/bluetooth/central_dfu_smp/sample.yaml
```yaml
sample:
  name: BLE Central DFU SMP
  description: Bluetooth Low Energy Central Device Firmware Update sample
tests:
  samples.bluetooth.central_dfu_smp:
    harness: bluetooth
    tags: bluetooth
  samples.bluetooth.central_dfu_smp.build:
    build_only: true
    build_on_all: true
      nrf5340dk_nrf5340_cpuapp nrf5340dk_nrf5340_cpuappns
    tags: bluetooth ci_build
```

## samples/bluetooth/central_hids/sample.yaml
```yaml
sample:
  name: BLE Central HIDS
  description: Bluetooth Low Energy central Human Interface Device sample
tests:
  samples.bluetooth.central_hids:
    harness: bluetooth
    tags: bluetooth
  samples.bluetooth.central_hids.build:
    build_only: true
    build_on_all: true
      nrf5340dk_nrf5340_cpuapp nrf5340dk_nrf5340_cpuappns
    tags: bluetooth ci_build
```

## samples/bluetooth/central_uart/sample.yaml
```yaml
sample:
  name: BLE Central UART
  description: Bluetooth Low Energy central UART sample
tests:
  samples.bluetooth.central_uart:
    build_only: true
    build_on_all: true
      nrf5340dk_nrf5340_cpuapp nrf5340dk_nrf5340_cpuappns
    tags: bluetooth ci_build
```

## samples/bluetooth/llpm/sample.yaml
```yaml
sample:
  name: BLE LLPM
  description: Buetooth Low Energy LLPM sample
tests:
  samples.bluetooth.llpm:
    build_only: true
    build_on_all: true
      nrf5340dk_nrf5340_cpuapp nrf5340dk_nrf5340_cpuappns
    tags: bluetooth ci_build
```

## samples/bluetooth/mesh/chat/sample.yaml
```yaml
sample:
  name: Bluetooth Mesh Chat
  description: Bluetooth Mesh Chat sample
tests:
  samples.bluetooth.mesh.chat:
    build_only: true
    build_on_all: true
      nrf5340dk_nrf5340_cpuapp nrf5340dk_nrf5340_cpuappns
    tags: bluetooth ci_build
```

## samples/bluetooth/mesh/light/sample.yaml
```yaml
sample:
  name: Bluetooth mesh light
  description: Bluetooth mesh light sample
tests:
  samples.bluetooth.mesh.light:
    build_only: true
    build_on_all: true
      nrf5340dk_nrf5340_cpuapp nrf5340dk_nrf5340_cpuappns
    tags: bluetooth ci_build
```

## samples/bluetooth/mesh/light_switch/sample.yaml
```yaml
sample:
  name: Bluetooth mesh light switch
  description: Bluetooth mesh light switch sample
tests:
  samples.bluetooth.mesh.light_switch:
    build_only: true
    build_on_all: true
      nrf5340dk_nrf5340_cpuapp nrf5340dk_nrf5340_cpuappns
    tags: bluetooth ci_build
```

## samples/bluetooth/peripheral_gatt_dm/sample.yaml
```yaml
sample:
  name: BLE Gatt Discovery
  description: Bluetooth Low Energy Gatt client discovery manager sample
tests:
  samples.bluetooth.peripheral_gatt_dm:
    build_only: true
    build_on_all: true
      nrf5340dk_nrf5340_cpuapp nrf5340dk_nrf5340_cpuappns
    tags: bluetooth ci_build
```

## samples/bluetooth/peripheral_hids_keyboard/sample.yaml
```yaml
sample:
  name: BLE HIDS keyboard sample
  description: Bluetooth Low Energy Human Interface Device keyboard sample
tests:
  samples.bluetooth.peripheral_hids_keyboard:
    harness: bluetooth
    tags: bluetooth
  samples.bluetooth.peripheral_hids_keyboard.build:
    build_only: true
    build_on_all: true
      nrf5340dk_nrf5340_cpuapp nrf5340dk_nrf5340_cpuappns
    tags: bluetooth ci_build
```

## samples/bluetooth/peripheral_hids_mouse/sample.yaml
```yaml
sample:
  name: BLE HIDS mouse sample
  description: Bluetooth Low Energy Human Interface Device mouse sample
tests:
  samples.bluetooth.peripheral_hids_mouse:
    harness: bluetooth
    tags: bluetooth
  samples.bluetooth.peripheral_hids_mouse.build:
    build_only: true
    build_on_all: true
      nrf5340dk_nrf5340_cpuapp nrf5340dk_nrf5340_cpuappns
    tags: bluetooth ci_build
```

## samples/bluetooth/peripheral_lbs/sample.yaml
```yaml
sample:
  name: BLE LED Button service
  description: Bluetooth Low Energy LED Button service sample
tests:
  samples.bluetooth.peripheral_lbs:
    build_only: true
    build_on_all: true
      nrf5340dk_nrf5340_cpuapp nrf5340dk_nrf5340_cpuappns
    tags: bluetooth ci_build
tests:
  samples.bluetooth.peripheral_lbs_minimal:
    extra_args: OVERLAY_CONFIG=minimal.conf
    build_only: true
    tags: bluetooth ci_build
```

## samples/bluetooth/shell_bt_nus/sample.yaml
```yaml
sample:
  name: BT NUS shell
  description: BT NUS shell sample
tests:
  samples.bluetooth.shell_bt_nus:
    build_only: true
    build_on_all: true
      nrf5340dk_nrf5340_cpuapp nrf5340dk_nrf5340_cpuappns
    tags: bluetooth ci_build
```

## samples/bluetooth/throughput/sample.yaml
```yaml
sample:
  name: BLE throughput
  description: Bluetooth Low Energy throughput sample
tests:
  samples.bluetooth.throughput:
    build_only: true
    build_on_all: true
      nrf5340dk_nrf5340_cpuapp nrf5340dk_nrf5340_cpuappns
    tags: bluetooth ci_build
```

## samples/esb/prx/sample.yaml
```yaml
sample:
  name: ESB prx Sample
tests:
  samples.esb.prx:
    filter: CONFIG_UART_CONSOLE and CONFIG_SERIAL_SUPPORT_INTERRUPT
    tags: samples console
    harness: keyboard
  samples.esb.prx.build:
    build_only: true
    build_on_all: true
    tags: ci_build
```

## samples/esb/ptx/sample.yaml
```yaml
sample:
  name: ESB ptx Sample
tests:
  samples.esb.ptx:
    filter: CONFIG_UART_CONSOLE and CONFIG_SERIAL_SUPPORT_INTERRUPT
    tags: samples console
    harness: keyboard
  samples.esb.ptx.build:
    build_only: true
    build_on_all: true
    tags: ci_build
```

## samples/peripheral/lpuart/sample.yaml
```yaml
sample:
  name: Low Power UART
  description: Low Power UART sample
tests:
  samples.peripheral.lpuart:
    build_only: true
    build_on_all: true
                    nrf5340dk_nrf5340_cpuapp nrf5340pdk_nrf5340_cpuapp
    tags: ci_build

  samples.peripheral.lpuart_int_driven:
    build_only: true
    build_on_all: true
                    nrf5340dk_nrf5340_cpuapp nrf5340pdk_nrf5340_cpuapp
    tags: ci_build
    extra_configs:
      - CONFIG_NRF_SW_LPUART_INT_DRIVEN=y
```

## samples/zigbee/light_switch/sample.yaml
```yaml
sample:
  name: Zigbee Light switch
  description: Zigbee dimmable light switch based on ZBOSS stack
tests:
  zigbee.light_switch:
    build_only: true
    tags: ci_build smoke

  zigbee.light_switch.fota:
    build_only: true
    tags: ci_build smoke
    extra_args: DOVERLAY_CONFIG=overlay-fota.conf

  zigbee.light_switch.fota_and_multiprotocol:
    build_only: true
    tags: ci_build
    extra_args: DOVERLAY_CONFIG=overlay-fota.conf DOVERLAY_CONFIG=overlay-multiprotocol_ble.conf

  zigbee.light_switch.multiprotocol:
    build_only: true
    tags: ci_build
    extra_args: DOVERLAY_CONFIG=overlay-multiprotocol_ble.conf

  zigbee.light_switch.current_measurement:
    build_only: true
    tags: ci_build
    extra_args: CONFIG_SERIAL=n
```

## samples/zigbee/ncp/sample.yaml
```yaml
sample:
  name: Zigbee NCP
  description: Zigbee network co-processor

tests:
  zigbee.ncp:
    build_only: true
    tags: ci_build

  zigbee.ncp.usb:
    build_only: true
    tags: ci_build
    extra_args: CONF_FILE=prj_usb.conf

  zigbee.ncp.with_nrf21540ek:
    build_only: true
    tags: ci_build
    extra_args: DTC_OVERLAY_FILE=boards/nrf52840dk_nrf52840.overlay;../common/dts-nrf21540-fem.overlay
```
